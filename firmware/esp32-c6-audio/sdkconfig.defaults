## firmware/esp32-c6-audio/sdkconfig.defaults
```kconfig
CONFIG_IDF_TARGET="esp32c6"
CONFIG_ESP_CONSOLE_USB_SERIAL_JTAG=y
CONFIG_ESP_CONSOLE_UART_DEFAULT=n
CONFIG_ESP_CONSOLE_SECONDARY_NONE=y
CONFIG_FREERTOS_HZ=1000
```

## firmware/esp32-s3-touch-lcd-7/main/Kconfig.projbuild
```kconfig
menu "Touch installation (private configuration)"
config TOUCH_VOICE
    bool "Enable authorized C6 voice capture"
    default n
config TOUCH_WIFI_SSID
    string "Installation Wi-Fi SSID"
    default ""
config TOUCH_WIFI_PASSWORD
    string "Installation Wi-Fi password"
    default ""
config TOUCH_HOST_URI
    string "Trusted local host /state WebSocket URI"
    default ""
endmenu
```

## firmware/esp32-s3-touch-lcd-7/sdkconfig.defaults
```kconfig
# ESP32-S3 Waveshare Touch LCD 7B Hardware Configuration
CONFIG_IDF_TARGET="esp32s3"

# CPU Frequency
CONFIG_ESP32S3_DEFAULT_CPU_FREQ_240=y
CONFIG_ESP32S3_DEFAULT_CPU_FREQ_MHZ=240

# Flash configuration (16MB Quad SPI)
CONFIG_ESPTOOLPY_FLASHSIZE_16MB=y
CONFIG_ESPTOOLPY_FLASHSIZE="16MB"
CONFIG_ESPTOOLPY_FLASHMODE_QIO=y
CONFIG_ESPTOOLPY_FLASHFREQ_80M=y

# PSRAM (8MB Octal SPI / OPI)
CONFIG_SPIRAM=y
CONFIG_SPIRAM_MODE_OCT=y
CONFIG_SPIRAM_TYPE_AUTO=y
CONFIG_SPIRAM_SPEED_80M=y
CONFIG_SPIRAM_MEMTEST=y
CONFIG_SPIRAM_USE_CAPS_ALLOC=y
CONFIG_SPIRAM_BOOT_INIT=y
CONFIG_SPIRAM_ALLOW_STACK_EXTERNAL_MEMORY=y

# Cache and Bus
CONFIG_ESP32S3_DATA_CACHE_64KB=y
CONFIG_ESP32S3_DATA_CACHE_LINE_64B=y
CONFIG_ESP32S3_INSTRUCTION_CACHE_32KB=y

# FreeRTOS
CONFIG_FREERTOS_HZ=1000
CONFIG_FREERTOS_UNICORE=n

# Common LCD and LVGL configurations
CONFIG_LV_COLOR_DEPTH_16=y
CONFIG_LV_COLOR_16_SWAP=0
CONFIG_LV_MEM_CUSTOM=y
CONFIG_LV_MEM_CUSTOM_INCLUDE="esp_heap_caps.h"
CONFIG_LV_DISP_DEF_REFR_PERIOD=16
CONFIG_LV_INDEV_DEF_READ_PERIOD=16

# Log Level
CONFIG_LOG_DEFAULT_LEVEL_INFO=y
```
